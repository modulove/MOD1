/*
This code was originally written by HAGIWO and released under CC0

HAGIWO MOD1 VCO Ver1.0
Audio output operation is somewhat unstable and produces a noise sound.

Square wave oscillator with V/oct support.
LFO for vibrato and octave like chiptune.
The capacitor in the D11 output circuit needs to be removed.

https://note.com/solder_state/n/nacfeb7b26e62

--Pin assign---
POT1  A0  frequency tune
POT2  A1  octave
POT3  A2  vibrato LFO level
F1    A3  V/oct CV in
F2    A4  octave CV in  
F3    A5  vibrato level CV in 
F4    D11 audio out
BUTTON    octave LFO on/off
LED       octave LFO on/off
EEPROM    N/A
*/

#include <avr/pgmspace.h>
#include <Arduino.h>

// pin definitions
const int OUTPUT_PIN = 11;     // tone output pin
const int POT_FREQ_PIN = A0;   // frequency control pot
const int POT_OCT_PIN = A1;    // octave selection pot
const int VOCT_PIN = A3;       // V/oct input pin
const int LFO_AMP_PIN = A2;    // LFO amplitude pot pin
const int CV_OCT_PIN = A4;     // additional CV input for octave pot
const int CV_LFO_PIN = A5;     // additional CV input for LFO amplitude pot

// Button stuff
const int buttonPin = 4;       // momentary push button pin
const int togglePin = 3;       // toggle output pin

// For button debounce
int lastButtonState = HIGH;          // button is HIGH when not pressed
unsigned long buttonPreviousMillis = 0;
const unsigned long debounceDelay = 50; // ms
bool toggleState = false;            // track HIGH/LOW state of D3

float rawVIn = 1;
float freq = 1;

// base frequency
const float BASE_FREQ = 40.0;

// limit for max frequency
const unsigned int MAX_FREQ = 20000;

// Octave map
int octMap[6] = { 1, 2, 4, 8, 16, 32 };

// V/Oct map
// Stored in flash memory
const float PROGMEM voctMap[1024] = {
1.000000, 1.003394, 1.006799, 1.010215, 1.013643, 1.017083, 1.020535, 1.023998, 1.027473, 1.030960, 1.034459, 1.037969,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 32.000000
};

// Variables for reading pots every 10ms
unsigned long lastPotUpdate = 0;   // track last time pots were read
float freqFactor = 1.0;           // store frequency factor from A0
int octave = 1;                   // store octave value from A1

// LFO variables
const float LFO_FREQUENCY = 10.0;  // 10Hz
float lfoPhase = 0.0;             // current phase of LFO
float lfoAmp = 0.0;               // LFO amplitude factor (up to ±5%)
unsigned long lastLfoUpdate = 0;  // track last time LFO phase was updated

// Chiptune-like toggling at 20Hz, one octave higher
const float CHIPTUNE_FREQ = 20.0;  // 20Hz
float chipPhase = 0.0;
unsigned long lastChipUpdate = 0;

//------------------------------------------------------------------------------
void handleButtonInput() {
  int reading = digitalRead(buttonPin); // LOW when pressed
  unsigned long currentMillis = millis();

  // Debounce check
  if (currentMillis - buttonPreviousMillis > debounceDelay) {
    // Detect transition HIGH->LOW (button press)
    if (reading == LOW && lastButtonState == HIGH) {
      // toggle D3
      toggleState = !toggleState;
      digitalWrite(togglePin, toggleState ? HIGH : LOW);

      buttonPreviousMillis = currentMillis;
    }
  }
  lastButtonState = reading;
}
//------------------------------------------------------------------------------

void setup() {
  // Set the tone output pin as output
  pinMode(OUTPUT_PIN, OUTPUT);

  // Setup for button and toggle pin
  pinMode(buttonPin, INPUT_PULLUP); // internal pullup
  pinMode(togglePin, OUTPUT);
  digitalWrite(togglePin, LOW);
}

void loop() {
  // Get current time in milliseconds
  unsigned long currentMillis = millis();

  // Handle button input
  handleButtonInput();

  // Read A0, A1 (plus A4), A2 (plus A5) only if at least 10ms have passed
  if (currentMillis - lastPotUpdate >= 10) {
    lastPotUpdate = currentMillis;  // update the time marker

    // Read A0 for frequency factor (0 -> 1.0, 1023 -> 2.0)
    float rawFreqVal = analogRead(POT_FREQ_PIN);  // read 0~1023
    freqFactor = 1.0 + (rawFreqVal / 1023.0);     // up to 2.0x

    // For octave pot on A1, add CV from A4
    int rawOctVal = analogRead(POT_OCT_PIN); // 0~1023
    int cvOctVal  = analogRead(CV_OCT_PIN);  // 0~1023
    int combinedOctVal = rawOctVal + cvOctVal;
    if (combinedOctVal > 1023) {
      combinedOctVal = 1023;
    }
    // octave = map(combinedOctVal, 0, 1023, 1, 6);
  if (combinedOctVal < 102) {
    octave = 1; 
  } else if (combinedOctVal < 308) {
    octave = 2; 
  } else if (combinedOctVal < 514) {
    octave = 3; 
  } else if (combinedOctVal < 720) {
    octave = 4; 
  } else if (combinedOctVal < 926) {
    octave = 5; 
  } else {
    octave = 6; 
  }

    // For LFO amplitude pot on A2, add CV from A5
    int rawLfoVal = analogRead(LFO_AMP_PIN); // 0~1023
    int cvLfoVal  = analogRead(CV_LFO_PIN);  // 0~1023
    int combinedLfoVal = rawLfoVal + cvLfoVal;
    if (combinedLfoVal > 1023) {
      combinedLfoVal = 1023;
    }
    lfoAmp = (combinedLfoVal / 1023.0) * 0.05; // max ±5%
  }

  // Update LFO phase
  unsigned long dt = currentMillis - lastLfoUpdate;
  float dtSec = dt / 1000.0; // convert to seconds
  lastLfoUpdate = currentMillis;

  // Increase phase
  lfoPhase += 2.0 * PI * LFO_FREQUENCY * dtSec;
  if (lfoPhase > TWO_PI) {
    lfoPhase -= TWO_PI; // wrap around
  }

  // Calculate LFO value (-1.0 ~ +1.0)
  float lfoVal = sin(lfoPhase);

  // Read A3 for V/oct input every loop
  rawVIn = analogRead(VOCT_PIN);  // 0~1023

  // Calculate base frequency
  freq = BASE_FREQ
         * freqFactor
         * pgm_read_float(&voctMap[(int)rawVIn])
         * octMap[octave - 1];

  // Apply LFO (±lfoAmp)
  freq *= (1.0 + (lfoVal * lfoAmp));

  // If D3 LED is HIGH, do 20Hz pitch toggling, 1oct up
  if (toggleState) {
    // Update phase for chiptune effect
    unsigned long dtChip = currentMillis - lastChipUpdate;
    float dtChipSec = dtChip / 1000.0;
    lastChipUpdate = currentMillis;

    chipPhase += 2.0 * PI * CHIPTUNE_FREQ * dtChipSec;
    if (chipPhase > TWO_PI) {
      chipPhase -= TWO_PI;
    }

    // Square wave: half cycle normal, half cycle 1 octave up
    if (sin(chipPhase) > 0) {
      freq *= 2.0; // 1 octave up
    }
  }

  // Limit frequency to MAX_FREQ
  if (freq > MAX_FREQ) {
    freq = MAX_FREQ;
  }

  // Output the tone on D11
  tone(OUTPUT_PIN, (unsigned int)freq);

  // No delay used, loop executes continuously
}
