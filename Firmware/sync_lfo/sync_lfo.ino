/*
  MOD1 SyncLFO with Self-Modulation v2.2
  Based on HAGIWO MOD1 SyncLFO (CC0)
  Enhanced with features from Sync Mod LFO
  
  Features:
  - Clock sync LFO with 6 waveforms + random
  - Self-modulation (POT3 while button pressed) - for non-random waveforms
  - Slew rate control (POT3 while button pressed) - for random mode
  - Internal rate control when no external clock (POT1)
  - Random mode clocked by external clock with divider
  - Pickup mode with deadzone to prevent parameter jumps
  
  --Pin assign---
  POT1  A0  div rate / internal rate (when no clock)
  POT2  A1  waveform select
  POT3  A2  output level / self-mod OR slew (when button pressed)
  F1    A3  external clock in
  F2    A4  div rate CV
  F3    A5  waveform select CV
  F4    D11 output
  BUTTON D4 modifier (self-mod for waveforms / slew for random)
  LED   D3 output indicator
*/

#include <avr/pgmspace.h>

#define TABLE_SIZE 1024
#define Brightness 64

// Pickup deadzone - pot must come within this range of stored value to "pick up"
#define PICKUP_DEADZONE 30

// Wave Tables
const byte PROGMEM SinTable[TABLE_SIZE] = {
  127, 128, 129, 129, 130, 131, 132, 132, 133, 134, 135, 136,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 126
};

const byte PROGMEM TriTable[TABLE_SIZE] = {
  0, 0, 0, 1, 1, 2, 2, 3, 3, 4, 4, 5,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 0
};

const byte PROGMEM SquTable[TABLE_SIZE] = {
  255, 255, 255, 255, 255, 255, 255, 255, 255, 255, 255, 255,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 0
};

const byte PROGMEM SawTable[TABLE_SIZE] = {
  0, 0, 0, 0, 0, 1, 1, 1, 1, 2, 2, 2,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 255
};

const byte PROGMEM SawRevTable[TABLE_SIZE] = {
  255, 254, 254, 254, 254, 253, 253, 253, 253, 252, 252, 252,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 0
};

const byte PROGMEM DecayTable[TABLE_SIZE] = {
  255, 254, 253, 252, 251, 250, 249, 248, 247, 246, 245, 244,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 5
};

// Clock tracking
unsigned long clockPeriods[3] = { 500000, 500000, 500000 };
byte clockIndex = 0;
unsigned long lastClockMicros = 0;
bool newClockReceived = false;
unsigned long lastClockTime = 0;

// LFO state
float waveIndex = 0.0;
float waveIncrement = 0.0;
int waveHeight = 255;
int waveForm = 0;

// Self-modulation state (for non-random waveforms)
int selfModType = 0;
float selfModAmount = 0.0;

// Slew state (for random mode)
float slewRate = 1.0;  // 1.0 = instant, 0.001 = very slow
float currentRandomOutput = 127.0;  // Smoothed output
byte targetRandomValue = 127;  // Target value to slew towards

// Internal clock
bool useInternalClock = true;
unsigned long internalPeriod = 500000;

// Timing
unsigned long previousMillis = 0;
unsigned long currentMillis = 0;

// Pin states
bool lastClockState = HIGH;
bool currentClockState = HIGH;
bool lastSwitchState = HIGH;
bool currentSwitchState = HIGH;
bool buttonHeld = false;
bool buttonWasHeld = false;

// Random mode
bool randomNeedsUpdate = false;

// Pickup state for POT3 only (POT2 no longer has alternate function)
int pot3StoredValue = 1023;
bool pot3PickedUp = true;

#define CLOCK_TIMEOUT 8000000UL

//======================================================
// Check if pot has "picked up" the stored value
//======================================================
bool checkPickup(int currentValue, int storedValue) {
  return abs(currentValue - storedValue) < PICKUP_DEADZONE;
}

//======================================================
// Get wave increment
//======================================================
float getWaveIncrement(float divFactor, unsigned long avgClockPeriod) {
  float freq = 1000000.0 / (float)avgClockPeriod;
  float increment = (freq / 1000.0) * TABLE_SIZE * divFactor;
  return increment;
}

void setup() {
  pinMode(17, INPUT_PULLUP);
  pinMode(3, OUTPUT);
  pinMode(11, OUTPUT);
  pinMode(4, INPUT_PULLUP);
  
  TCCR2A = (1 << WGM21) | (1 << WGM20) | (1 << COM2B1);
  TCCR2B = (1 << CS20);
  TCCR1A = (1 << WGM11) | (1 << COM1A1);
  TCCR1B = (1 << WGM13) | (1 << WGM12) | (1 << CS10);
  ICR1 = 255;
  
  randomSeed(analogRead(A3));
  
  pot3StoredValue = analogRead(A2);
}

void loop() {
  currentMillis = millis();
  unsigned long now = micros();
  
  //========================
  // Poll external clock (D17)
  //========================
  currentClockState = digitalRead(17);
  
  if (lastClockState == LOW && currentClockState == HIGH) {
    unsigned long thisPeriod = now - lastClockMicros;
    lastClockMicros = now;
    lastClockTime = now;
    
    clockPeriods[clockIndex] = thisPeriod;
    clockIndex = (clockIndex + 1) % 3;
    
    waveIndex = 0.0;
    newClockReceived = true;
    useInternalClock = false;
  }
  lastClockState = currentClockState;
  
  //========================
  // Clock timeout check
  //========================
  if (!useInternalClock && (now - lastClockTime > CLOCK_TIMEOUT)) {
    useInternalClock = true;
  }
  
  //========================
  // Poll button (D4)
  //========================
  currentSwitchState = digitalRead(4);
  buttonWasHeld = buttonHeld;
  buttonHeld = (currentSwitchState == LOW);
  
  // Detect button release - set up pickup mode for POT3
  if (buttonWasHeld && !buttonHeld) {
    pot3StoredValue = waveHeight * 4;
    pot3PickedUp = false;
  }
  
  // Button can also trigger clock
  if (lastSwitchState == LOW && currentSwitchState == HIGH) {
    unsigned long thisPeriod = now - lastClockMicros;
    lastClockMicros = now;
    lastClockTime = now;
    
    clockPeriods[clockIndex] = thisPeriod;
    clockIndex = (clockIndex + 1) % 3;
    
    waveIndex = 0.0;
    newClockReceived = true;
    useInternalClock = false;
  }
  lastSwitchState = currentSwitchState;
  
  //========================
  // Calculate average period
  //========================
  static unsigned long avgPeriod = 500000;
  if (newClockReceived) {
    unsigned long total = 0;
    for (int i = 0; i < 3; i++) {
      total += clockPeriods[i];
    }
    avgPeriod = total / 3UL;
    if (avgPeriod < 1000) avgPeriod = 1000;
    newClockReceived = false;
  }
  
  //========================
  // Read pots
  //========================
  int potA0 = analogRead(A0);
  int potA1 = analogRead(A1);
  int potA2 = analogRead(A2);
  int cvA4 = analogRead(A4);
  int cvA5 = analogRead(A5);
  
  // POT1 (A0): Divider or Internal Rate
  float divFactor = 1.0;
  if (useInternalClock) {
    internalPeriod = map(potA0, 0, 1023, 50000, 4000000);
  } else {
    int divValue = min(potA0 + cvA4, 1023);
    if (divValue < 102) divFactor = 1.0;
    else if (divValue < 308) divFactor = 2.0;
    else if (divValue < 514) divFactor = 3.0;
    else if (divValue < 720) divFactor = 4.0;
    else if (divValue < 926) divFactor = 5.0;
    else divFactor = 6.0;
  }
  
  //========================
  // POT2 (A1): Waveform select (always active, no alternate function)
  //========================
  waveForm = min(potA1 + cvA5, 1023);
  
  // Check if we're in random mode
  bool isRandomMode = (waveForm > 926);
  
  //========================
  // POT3 (A2): Level / Self-mod / Slew with pickup
  //========================
  if (buttonHeld) {
    if (isRandomMode) {
      // Slew rate control for random mode
      // POT at 0 (CCW) = instant (no slew), POT at max (CW) = very slow slew
      // Using exponential mapping for more usable range
      float slewControl = potA2 / 1023.0;  // 0.0 to 1.0
      
      if (slewControl < 0.02) {
        // Near zero = instant, no slew
        slewRate = 1.0;
      } else {
        // Exponential curve: more resolution at slow end
        // Maps 0.02-1.0 to slewRate 0.5 down to 0.0005
        float normalized = (slewControl - 0.02) / 0.98;  // 0 to 1
        // Exponential: slower values get more pot travel
        slewRate = 0.5 * pow(0.001, normalized);  // 0.5 down to 0.0005
      }
    } else {
      // Self-modulation control for non-random waveforms
      int modControl = potA2;
      if (modControl < 85) {
        selfModType = 0;
        selfModAmount = 0.0;
      } else if (modControl < 256) {
        selfModType = 1;
        selfModAmount = (modControl - 85) / 170.0;
      } else if (modControl < 427) {
        selfModType = 2;
        selfModAmount = (modControl - 256) / 170.0;
      } else if (modControl < 598) {
        selfModType = 3;
        selfModAmount = (modControl - 427) / 170.0;
      } else if (modControl < 769) {
        selfModType = 4;
        selfModAmount = (modControl - 598) / 170.0;
      } else if (modControl < 940) {
        selfModType = 5;
        selfModAmount = (modControl - 769) / 170.0;
      } else {
        selfModType = 6;
        selfModAmount = (modControl - 940) / 83.0;
      }
      if (selfModAmount > 1.0) selfModAmount = 1.0;
    }
  } else {
    // Level mode with pickup
    if (!pot3PickedUp) {
      if (checkPickup(potA2, pot3StoredValue)) {
        pot3PickedUp = true;
      }
    }
    
    if (pot3PickedUp) {
      waveHeight = min(potA2 / 4, 255);
    }
  }
  
  //========================
  // Update LFO every 1ms
  //========================
  if (currentMillis - previousMillis >= 1) {
    previousMillis = currentMillis;
    
    unsigned long period = useInternalClock ? internalPeriod : avgPeriod;
    waveIncrement = getWaveIncrement(divFactor, period);
    
    waveIndex += waveIncrement;
    if (waveIndex >= TABLE_SIZE) {
      waveIndex -= TABLE_SIZE;
      
      // For random mode, update on cycle completion (respects divider)
      if (isRandomMode) {
        randomNeedsUpdate = true;
      }
    }
    
    // Calculate output
    long outputValue = 0;
    
    if (isRandomMode) {
      // Random mode with slew
      if (randomNeedsUpdate) {
        targetRandomValue = random(0, 256);
        randomNeedsUpdate = false;
      }
      
      // Apply slew - move current towards target
      float diff = (float)targetRandomValue - currentRandomOutput;
      currentRandomOutput += diff * slewRate;
      
      // Clamp
      if (currentRandomOutput > 255.0) currentRandomOutput = 255.0;
      if (currentRandomOutput < 0.0) currentRandomOutput = 0.0;
      
      outputValue = (long)currentRandomOutput * waveHeight / 255;
    } else {
      // Non-random waveforms with optional self-modulation
      int currentIdx = (int)waveIndex;
      int modPhase = 0;
      
      // Apply self-modulation
      if (selfModType > 0 && selfModAmount > 0.01) {
        int modValue = 0;
        switch (selfModType) {
          case 1: modValue = pgm_read_byte(&SinTable[currentIdx]) - 127; break;
          case 2: modValue = pgm_read_byte(&TriTable[currentIdx]) - 127; break;
          case 3: modValue = pgm_read_byte(&SquTable[currentIdx]) - 127; break;
          case 4: modValue = pgm_read_byte(&SawTable[currentIdx]) - 127; break;
          case 5: modValue = pgm_read_byte(&SawRevTable[currentIdx]) - 127; break;
          case 6: modValue = random(-127, 128); break;
        }
        modPhase = (int)(modValue * selfModAmount * 4.0);
      }
      
      int idx = (currentIdx + modPhase) % TABLE_SIZE;
      while (idx < 0) idx += TABLE_SIZE;
      while (idx >= TABLE_SIZE) idx -= TABLE_SIZE;
      
      byte waveVal;
      if (waveForm <= 102) {
        waveVal = pgm_read_byte(&SinTable[idx]);
      } else if (waveForm <= 308) {
        waveVal = pgm_read_byte(&TriTable[idx]);
      } else if (waveForm <= 514) {
        waveVal = pgm_read_byte(&SquTable[idx]);
      } else if (waveForm <= 720) {
        waveVal = pgm_read_byte(&SawTable[idx]);
      } else {
        waveVal = pgm_read_byte(&SawRevTable[idx]);
      }
      
      outputValue = (long)waveVal * waveHeight / 255;
    }
    
    if (outputValue > 255) outputValue = 255;
    if (outputValue < 0) outputValue = 0;
    
    analogWrite(11, outputValue);
    analogWrite(3, (byte)(outputValue * Brightness / 255));
  }
}
