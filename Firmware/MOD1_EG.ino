/*
This code was originally written by HAGIWO and released under CC0

HAGIWO MOD1 EG Ver1.0
https://note.com/solder_state/n/n7499f01be846
3-output EG. end-of-cycle outputs can be self-patched for use as LFO or clock source.

--Pin assign---
POT1  A0  Attack time
POT2  A1  Release Time
POT3  A2  Output Level
F1    D17 Trigger IN
F2    D9  End of cycle Pulse output
F3    D10 Inverted EG output
F4    D11 EG output
BUTTON    Trigger
LED       output
EEPROM    N/A
*/
#define TABLE_SIZE 1024
#define Brightness 160  //0 - 255

const static PROGMEM byte Curve[1024] = {
  255, 254, 253, 252, 251, 250, 249, 248, 247, 246, 245, 244,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 0
};

const static PROGMEM int PotAdjust[1024] = {
  0, 5, 10, 15, 20, 25, 30, 35, 39, 44, 49, 54,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 1023
};



float waveIndex = 0;
int outputValue = 0;
int lastout = 0;

unsigned long previousMillis = 0;  // previous sample time
unsigned long currentMillis = 0;
bool lastButtonState = HIGH;  // last button sutate

int readingButton = 0;
bool lastreadingButtonState = 0;

int readingSignal = 0;
bool lastreadingSignalState = 0;

int state = 0;  //0=no triggerd , 1=atk,2=rel.3=EoC

bool EoC = 0;
int EoCcount = 0;

void setup() {
  pinMode(4, INPUT_PULLUP);  //button setting
  pinMode(17, INPUT);        //button setting
  pinMode(3, OUTPUT);        //LED setting
  pinMode(9, OUTPUT);        // EoC out
  pinMode(10, OUTPUT);       //EG out
  pinMode(11, OUTPUT);       //inv EG out

  TCCR2A = (1 << WGM21) | (1 << WGM20) | (1 << COM2B1);//fast PWM 62.5kHz setting
  TCCR2B = (1 << CS20);//fast PWM 62.5kHz setting
  TCCR1A = (1 << WGM11) | (1 << COM1A1);//fast PWM 62.5kHz setting
  TCCR1B = (1 << WGM13) | (1 << WGM12) | (1 << CS10);//fast PWM 62.5kHz setting
  ICR1 = 255;//fast PWM 62.5kHz setting
}


void loop() {
  currentMillis = millis();

  // Detection of button press
  lastreadingSignalState = readingSignal;
  readingSignal = digitalRead(4);
  if (lastreadingSignalState == 1 && readingSignal == 0) {
    if (state == 2) {
      lastout = outputValue;
    } else if (state != 2) {
      lastout = 0;
    }
    state = 1;
    waveIndex = 0;
  }

  lastreadingButtonState = readingButton;
  readingButton = digitalRead(17);
  if (lastreadingButtonState == 1 && readingButton == 0) {
    if (state == 2) {
      lastout = outputValue;
    } else if (state != 2) {
      lastout = 0;
    }
    state = 1;
    waveIndex = 0;
  }


  int atkTime = 1024 - pgm_read_word(&PotAdjust[analogRead(A0)]);  //atk time
  int relTime = 1024 - pgm_read_word(&PotAdjust[analogRead(A1)]);  //rel time
  int waveHeight = analogRead(A2) / 4;                             //level

  if (currentMillis - previousMillis >= 1) {
    previousMillis = currentMillis;
    if (atkTime > 1020 && state == 1) {
      state = 2;
      waveIndex = TABLE_SIZE;
    }
    if (state == 0) {
      outputValue = 0;
    }

    if (state == 1) {
      outputValue = map(pgm_read_byte(&Curve[(int)waveIndex]), 0, 255, 255, lastout) * waveHeight / 255;
      waveIndex = waveIndex + 0.05 * atkTime / 2;
    }
    if (state == 2) {
      outputValue = map(pgm_read_byte(&Curve[(int)waveIndex - TABLE_SIZE]), 0, 255, 0, 255) * waveHeight / 255;
      waveIndex = waveIndex + 0.05 * relTime / 2;
    }

    analogWrite(11, outputValue);                    //output LFO waveform
    analogWrite(3, outputValue * Brightness / 255);  //output LED
    analogWrite(10, 255 - outputValue);  //output inverse EG
    digitalWrite(9, EoC);

    if ((waveIndex > TABLE_SIZE) && (waveIndex < 2 * TABLE_SIZE)) {
      state = 2;
    };
    if (waveIndex >= 2 * TABLE_SIZE) {
      waveIndex = 0;
      state = 0;
      EoC = 1;
    }

    if (EoC == 1) {
      EoCcount++;
      if (EoCcount > 10) {
        EoCcount = 0;
        EoC = 0;
      }
    }
  };
}
